## config/west.yml
```yaml
manifest:
  remotes:
    - name: ergohaven
      url-base: https://github.com/ergohaven
    - name: urob
      url-base: https://github.com/urob
  projects:
    - name: ergohaven-zmk
      remote: ergohaven
      revision: main
      import: config/west.yml
    - name: zmk-tri-state
      remote: urob
      path: modules/zmk/tri-state
      revision: 2007896c6d5bfb519e8babccf8633841c5647d8b
  self:
    path: config
```
